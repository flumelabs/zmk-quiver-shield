## boards/shields/quiver/Kconfig.defconfig
```kconfig
if SHIELD_QUIVER_LEFT

config ZMK_KEYBOARD_NAME
    default "Quiver"

config ZMK_SPLIT_ROLE_CENTRAL
    default y

endif

if SHIELD_QUIVER_LEFT || SHIELD_QUIVER_RIGHT

config ZMK_SPLIT
    default y

config I2C
    default y

endif
```

## boards/shields/quiver/Kconfig.shield
```kconfig
config SHIELD_QUIVER_LEFT
    def_bool $(shields_list_contains,quiver_left)

config SHIELD_QUIVER_RIGHT
    def_bool $(shields_list_contains,quiver_right)
```
